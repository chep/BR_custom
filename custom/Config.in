## custom/Config.in
```kconfig
menu "Custom"

config BR2_CUSTOM
	bool "Customization for specific project"
	help
	  Enable this option if you want to customize buildroot for your 
	  embedded device

if BR2_CUSTOM
# Projects
source "../custom/projects/Config.in"
# Drivers	
source "../custom/drivers/Config.in"
# Libs
source "../custom/libs/Config.in"
# Tools
source "../custom/tools/Config.in"

endif # BR2_CUSTOM

endmenu
```

## custom/drivers/Config.in
```kconfig
menu "Drivers"

config BR2_CUSTOM_DRIVERS
	bool "Add specific drivers for the project"
	help
	  Enable this option if you want to add drivers for your embedded device

if BR2_CUSTOM_DRIVERS
	
#source "custom/drivers/*/Config.in"

endif # BR2_CUSTOM

endmenu
```

## custom/libs/Config.in
```kconfig
menu "Libraries"

config BR2_CUSTOM_LIBS
	bool "Add specific libraries"
	help
	  Enable this option if you want to add libraries not integrated to buildroot

#Add your libs here

#Example:
#source "../custom/libs/ecl/Config.in"

endmenu
```

## custom/libs/ecl/Config.in
```kconfig
config BR2_PACKAGE_ECL
	bool "ecl"
	depends on BR2_CUSTOM_LIBS
	help
	  Easy C library
```

## custom/projects/Config.in
```kconfig
menu "Project specific configuration"
	choice
		prompt "Choose default project"
        default BR2_CUSTOM_PROJECTS_NONE
		config BR2_CUSTOM_PROJECTS_NONE
			bool "None"

		#add your projects here:

		#Example:
		# config BR2_CUSTOM_PROJECTS_ARMCRBK
		# 	bool "ARM ChromeBook"

	endchoice

	# source Config.in of your projects here

	# Example:
	# if BR2_CUSTOM_PROJECTS_ARMCRBK
	# source "../custom/projects/arm-chromebook/Config.in"
	# endif

endmenu
```

## custom/tools/Config.in
```kconfig
menu "Tools"

config BR2_CUSTOM_TOOLS
	bool "Add specific tools"
	help
		Enable this option if you want to add tools not integrated in buildroot

source "custom/tools/jsonrw/Config.in"

endmenu
```

## custom/tools/jsonrw/Config.in
```kconfig
config BR2_PACKAGE_JSONRW
	bool "jsonrw"
	depends on BR2_CUSTOM_TOOLS
	help
	  Tools to read/write information from/to json file in shell script
```
